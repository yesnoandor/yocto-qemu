## build/conf/bblayers.conf
```bitbake
# POKY_BBLAYERS_CONF_VERSION is increased each time build/conf/bblayers.conf
# changes incompatibly
POKY_BBLAYERS_CONF_VERSION = "2"

BBPATH = "${TOPDIR}"
BBFILES ?= ""

BBLAYERS ?= " \
  /home/wenyu/server/ext-disk/grea/qemu/poky/meta \
  /home/wenyu/server/ext-disk/grea/qemu/poky/meta-poky \
  /home/wenyu/server/ext-disk/grea/qemu/poky/meta-yocto-bsp \
  /home/wenyu/server/ext-disk/grea/qemu/poky/meta-yocto-avs \
  "
```

## poky/meta-yocto-avs/conf/layer.conf
```bitbake
# We have a conf and classes directory, add to BBPATH
BBPATH .= ":${LAYERDIR}"

# We have recipes-* directories, add to BBFILES
BBFILES += "${LAYERDIR}/recipes-*/*/*.bb \
	${LAYERDIR}/recipes-*/*/*.bbappend"

BBFILE_COLLECTIONS += "meta-yocto-avs"
BBFILE_PATTERN_meta-yocto-avs = "^${LAYERDIR}/"
BBFILE_PRIORITY_meta-yocto-avs = "6"
LAYERSERIES_COMPAT_meta-yocto-avs = "sumo"

# append tools
CORE_IMAGE_EXTRA_INSTALL += "nano"
CORE_IMAGE_EXTRA_INSTALL += "adb-tools"
CORE_IMAGE_EXTRA_INSTALL += "dlt-daemon"
CORE_IMAGE_EXTRA_INSTALL += "i2c-tools"

# append apps
CORE_IMAGE_EXTRA_INSTALL += "linux-photo"
CORE_IMAGE_EXTRA_INSTALL += "linux-video"
CORE_IMAGE_EXTRA_INSTALL += "linux-video2lcd"
CORE_IMAGE_EXTRA_INSTALL += "ratchet"

# append shell
CORE_IMAGE_EXTRA_INSTALL += "hello-shell"

# append .a or .so
IMAGE_INSTALL_append += "lib-debug"
IMAGE_INSTALL_append += "lib-list-staticdev"
IMAGE_INSTALL_append += "googletest-staticdev"
IMAGE_INSTALL_append += "gsl"
IMAGE_INSTALL_append += "vsomeip"

# append test
IMAGE_INSTALL_append += "libdebug-test"
IMAGE_INSTALL_append += "liblist-test"
IMAGE_INSTALL_append += "libzmq-recv-test"
IMAGE_INSTALL_append += "libzmq-send-test"
IMAGE_INSTALL_append += "simple-mod-test"

# append kernel drivers
MACHINE_ESSENTIAL_EXTRA_RRECOMMENDS += "simple-mod"
KERNEL_MODULE_AUTOLOAD += "simple_mod"
```
